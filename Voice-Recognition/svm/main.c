#include "stm32f4xx.h"
#include "misc.h"
#include "stm32f4xx_usart.h"
#include "stm32f4xx_gpio.h"
#include "stm32f4xx_dma.h"
#include "stm32f4xx_rcc.h"
#include "arm_math.h"
#include <stdio.h>
#include <stdlib.h>
#include <math.h>

typedef struct
{
  float real;
  float imag;
 }COMPLEX;


#define BUFFERSIZE 2048
#define windowLength 1024
int Threshold=-200;
uint8_t usart[BUFFERSIZE];
float nonpermanentbuffer[windowLength/2];
float Pi=3.1415926;
float Fs=44100;
float mfccParamsmfccFilterWeights[40][80];
float mfccParamsmfccDCTMatrix[13][40];
float collect=0;
float collect2=0;
float testOutput[1024];
float hamming_window[1024];
float usartreal[windowLength];
float mfccs_block[13][40];
float ceps[13];
COMPLEX testInput[windowLength];
int i,k,n=0;

void Delay(uint32_t delay) {
    while (delay--);
}

void NVIC_Configuration(void){
 NVIC_InitTypeDef NVIC_InitStructure; 
           /* Enable the DMA Stream IRQ Channel */
  NVIC_InitStructure.NVIC_IRQChannel = DMA2_Stream2_IRQn;
  NVIC_InitStructure.NVIC_IRQChannelPreemptionPriority = 0;
  NVIC_InitStructure.NVIC_IRQChannelSubPriority = 0;
  NVIC_InitStructure.NVIC_IRQChannelCmd = ENABLE;
  NVIC_Init(&NVIC_InitStructure);
}

void USART1_Configuration(void){

  /* USART1 clocku ayarlanýyor */
  RCC_APB2PeriphClockCmd(RCC_APB2Periph_USART1, ENABLE);
   
  /* USART1 tx ve rx pinlerinin dahil olduðu GPIOB clock ayarý yapýlýyor */
  RCC_AHB1PeriphClockCmd(RCC_AHB1Periph_GPIOB, ENABLE);
  
  GPIO_InitTypeDef GPIO_InitStructure; //GPIO ayarlama açýlýyor
  /*-------------------------- GPIO Configuration ----------------------------*/
  GPIO_InitStructure.GPIO_Pin = GPIO_Pin_6 | GPIO_Pin_7; //pin 6 ve pin 7 seçiliyor
  GPIO_InitStructure.GPIO_Mode = GPIO_Mode_AF; //alternatif fonksiyon mode olarak ayarlanýyor zaten bu pinler kit tarafýndan usart1 için ayarlanmýþ pinler
  GPIO_InitStructure.GPIO_OType = GPIO_OType_PP; //pin çýkýþlarý lojik 1 olarak ayarlanýr
  GPIO_InitStructure.GPIO_PuPd = GPIO_PuPd_NOPULL; //pull up ve pull down dirençleri aktif deðildir
  GPIO_InitStructure.GPIO_Speed = GPIO_Speed_50MHz; //pin hýzý 50MHz seçildi
  GPIO_Init(GPIOB, &GPIO_InitStructure);
   
  /* USART1 pinleri AF Mode a dahil olduðu için belirtmemiz gerekir */
  GPIO_PinAFConfig(GPIOB, GPIO_PinSource6, GPIO_AF_USART1); // USART1_TX pini
  GPIO_PinAFConfig(GPIOB, GPIO_PinSource7, GPIO_AF_USART1); // USART1_RX pini
 
  USART_InitTypeDef USART_InitStructure; //Usart1 ayarlamasý açýldý   
  /* 
        - BaudRate = 115200 baud
        - Word Length = 8 Bits
        - One Stop Bit
        - No parity
        - Hardware flow control disabled (RTS and CTS signals)
        - Receive and transmit enabled
  */
  USART_InitStructure.USART_BaudRate = 115200;
  USART_InitStructure.USART_WordLength = USART_WordLength_8b; //usart bit uzunluðu 8bit
  USART_InitStructure.USART_StopBits = USART_StopBits_1;     // 1 adet stop biti
  USART_InitStructure.USART_Parity = USART_Parity_No;       // baþlangýç biti yok
  USART_InitStructure.USART_HardwareFlowControl = USART_HardwareFlowControl_None; //rts ve cts veri iletiþimi için kullanýlan diðer pinler þuan için gerekli deðil
   
  USART_InitStructure.USART_Mode = USART_Mode_Rx | USART_Mode_Tx; // Usart veri alma ve gönderme iþlemleri aktif
   
  USART_Init(USART1, &USART_InitStructure); //Usart ayarlamasý bitti

   
  USART_Cmd(USART1, ENABLE); //Usart1 aktif halde
}

void DMA_Configuration(void){
  DMA_InitTypeDef DMA_InitStructure;
  
  RCC_AHB1PeriphClockCmd(RCC_AHB1Periph_DMA2, ENABLE);
  
  DMA_InitStructure.DMA_Channel = DMA_Channel_4;//dma kanalý seçildi
  DMA_InitStructure.DMA_Memory0BaseAddr = (uint32_t)&usart[0]; //hafýzanýn baþlayacaðý adres belirtildi
  DMA_InitStructure.DMA_PeripheralBaseAddr = (uint32_t)&USART1->DR; //taþýnacak verinin adresi belirtildi
  DMA_InitStructure.DMA_DIR = DMA_DIR_PeripheralToMemory; // verinin taþýma yönü belirtildi 
  DMA_InitStructure.DMA_BufferSize = BUFFERSIZE;     //buffer büyüklüðü dma ya bildiriliyor
  DMA_InitStructure.DMA_PeripheralInc = DMA_PeripheralInc_Disable; //adc verilerinin bulunduðu register adresinde bir artýrma olmayacak
  DMA_InitStructure.DMA_MemoryInc = DMA_MemoryInc_Enable; //hafýzanýn artacaðý belirtildi
  DMA_InitStructure.DMA_PeripheralDataSize = DMA_PeripheralDataSize_Byte; //adc verilerinin uzunluðu 16 bit seçildi
  DMA_InitStructure.DMA_MemoryDataSize = DMA_MemoryDataSize_Byte; // hafýza verilerinin uzunluðu 16 bit seçildi
  DMA_InitStructure.DMA_Mode = DMA_Mode_Circular; //dma mod normal
  DMA_InitStructure.DMA_Priority = DMA_Priority_High; //bir çok dma kanalý aktif iken kullanýlýr dma önceliði yüksek olarak seçiliyor
  DMA_InitStructure.DMA_FIFOMode = DMA_FIFOMode_Enable; //fifo mode kapalý dma da peripheral ve memory arasýnda fifo bellekler (sram) bulunur 
  //fifo mode kapalýyken direct mode, açýkken burst mode kullanýlabilir.
  DMA_InitStructure.DMA_FIFOThreshold = DMA_FIFOThreshold_HalfFull; //(1/4,1/2,3/4,Full)  
  //single,INC4,INC8 ve INC16
  DMA_InitStructure.DMA_MemoryBurst = DMA_MemoryBurst_Single;  
  DMA_InitStructure.DMA_PeripheralBurst = DMA_PeripheralBurst_Single; 
  DMA_Init(DMA2_Stream2, &DMA_InitStructure);
  DMA_ITConfig(DMA2_Stream2, DMA_IT_TC | DMA_IT_HT, ENABLE); 
  USART_DMACmd(USART1,USART_DMAReq_Rx,ENABLE);    
  DMA_Cmd(DMA2_Stream2, ENABLE);/* DMA2_Stream0 aktif halde */
}
  

void feature_mfccs_init(void){
 ///////////////////////////////////////////////////////
    /////////#define mfccParamscepstralCoefficients 13
  float mfccParamslogFilters =27;
  float mfccParamsfftSize = 512 ;
  float mfccParamscepstralCoefficients =13;
  float mfccParamstotalFilters =40;
  // fft resolution:
/////////#define mfccParamsfftSize  512 //round( windowLength / 2)
  // filter parameters:
  float mfccParamslowestFrequency =133.3333;
  float mfccParamslinearSpacing =66.66666666;
 //////// double mfccParamslogFilters =27;
  float mfccParamslogSpacing =1.0711703;
  float mfccParamsfreqs[42];
/////////#define mfccParamstotalFilters 40 //( mfccParamslinearFilters + mfccParamslogFilters)

  //  mfccParamsfreqs = mfccParamslowestFrequency + (0:mfccParamslinearFilters-1)*mfccParamslinearSpacing;
  int a=0,b;
  for(a=0;a<13;a++)
    mfccParamsfreqs[a] = mfccParamslowestFrequency + a*mfccParamslinearSpacing;

 // mfccParamsfreqs(mfccParamslinearFilters+1:mfccParamstotalFilters+2) = mfccParamsfreqs(mfccParamslinearFilters) * mfccParamslogSpacing.^(1:mfccParamslogFilters+2);

  for(a=1;a<=mfccParamslogFilters+2;a++)
    mfccParamsfreqs[12+a]=mfccParamsfreqs[12]*pow(mfccParamslogSpacing,a);

//  mfccParamslower = mfccParamsfreqs(1:mfccParamstotalFilters);
  float mfccParamslower[40];

  for(a=0;a<mfccParamstotalFilters;a++)
    mfccParamslower[a] = mfccParamsfreqs[a];

//  mfccParamscenter = mfccParamsfreqs(2:mfccParamstotalFilters+1);
  float mfccParamscenter[40];

  for(a=1;a<mfccParamstotalFilters+1;a++)
    mfccParamscenter[a-1] = mfccParamsfreqs[a];

//  mfccParamsupper = mfccParamsfreqs(3:mfccParamstotalFilters+2);
  float mfccParamsupper[40];

  for(a=2;a<mfccParamstotalFilters+2;a++)
    mfccParamsupper[a-2] = mfccParamsfreqs[a];

//  mfccParamsmfccFilterWeights = zeros(mfccParamstotalFilters,mfccParamsfftSize);
////////   double mfccParamsmfccFilterWeights[mfccParamstotalFilters][mfccParamsfftSize];

//  mfccParamstriangleHeight = 2./(mfccParamsupper-mfccParamslower);
   float  mfccParamstriangleHeight[40];

   for(a=0;a<mfccParamstotalFilters;a++)
     mfccParamstriangleHeight[a] = 2/(mfccParamsupper[a]-mfccParamslower[a]);

//  mfccParamsfftFreqs = (0:mfccParamsfftSize-1)/mfccParamsfftSize*fs;
   float mfccParamsfftFreqs[512]; //mfccParamsfftSize

   for(a=0;a<mfccParamsfftSize;a++)
      mfccParamsfftFreqs[a]=Fs*a/mfccParamsfftSize;

 ///////////////////
 /* for chan=1:mfccParamstotalFilters //for each filter:
    // compute the respective filter weights:
    mfccParamsmfccFilterWeights(chan,:) = (mfccParamsfftFreqs > mfccParamslower(chan) & mfccParamsfftFreqs <= mfccParamscenter(chan))     .* mfccParamstriangleHeight(chan)   .*(mfccParamsfftFreqs-mfccParamslower(chan))/(mfccParamscenter(chan)-mfccParamslower(chan)) + (mfccParamsfftFreqs > mfccParamscenter(chan) & mfccParamsfftFreqs < mfccParamsupper(chan)).* mfccParamstriangleHeight(chan).*(mfccParamsupper(chan)-mfccParamsfftFreqs)/(mfccParamsupper(chan)-mfccParamscenter(chan));
  end
*/

  for(a=0;a<mfccParamstotalFilters;a++)
    for(b=0;b<mfccParamsfftSize;b++)
      mfccParamsmfccFilterWeights[a][b] =((mfccParamsfftFreqs[b] > mfccParamslower[a]) & (mfccParamsfftFreqs[b] <= mfccParamscenter[a]))*mfccParamstriangleHeight[a]*(mfccParamsfftFreqs[b]-mfccParamslower[a])/(mfccParamscenter[a]-mfccParamslower[a]) + ((mfccParamsfftFreqs[b] > mfccParamscenter[a]) & (mfccParamsfftFreqs[b] < mfccParamsupper[a]))* mfccParamstriangleHeight[a]*(mfccParamsupper[a]-mfccParamsfftFreqs[b])/(mfccParamsupper[a]-mfccParamscenter[a]);

  ////////////////
  // matrix used in the DCT calculation:
 // mfccParamsmfccDCTMatrix = 1/sqrt(mfccParamstotalFilters/2)*cos( (0:(mfccParamscepstralCoefficients-1))' * (2*(0:(mfccParamstotalFilters-1))+1) * pi/2/mfccParamstotalFilters);
 // mfccParamsmfccDCTMatrix(1,:) = mfccParamsmfccDCTMatrix(1,:) * sqrt(2)/2;
/////////////////  double mfccParamsmfccDCTMatrix[mfccParamscepstralCoefficients][mfccParamstotalFilters];
  for (a = 0; a<mfccParamscepstralCoefficients; a++)
    for (b = 0; b<mfccParamstotalFilters; b++){
              mfccParamsmfccDCTMatrix[a][b] =1/sqrt(mfccParamstotalFilters/2)* cos( a*(2*b+1)* Pi/2/mfccParamstotalFilters);
    }
  
   for (b = 0; b<mfccParamstotalFilters; b++)
         mfccParamsmfccDCTMatrix[0][b] =mfccParamsmfccDCTMatrix[0][b]*sqrt(2)/2;
    ///////////////////////////////////////////////////////
    
}

void GPIO_Configuration(void){
  GPIO_InitTypeDef GPIO_InitDef;
  RCC_AHB1PeriphClockCmd(RCC_AHB1Periph_GPIOD, ENABLE);// Hangi port olduðunu belirliyoruz (D portu)
  /*xxx*/
  GPIO_InitDef.GPIO_Pin = GPIO_Pin_12 | GPIO_Pin_13 | GPIO_Pin_14 | GPIO_Pin_15 ; // hangi pini kullanacaðýmýzý belirliyoruz (12. pin)
  GPIO_InitDef.GPIO_Mode = GPIO_Mode_OUT; // çýkýþ olarak ayarlýyoruz
  GPIO_InitDef.GPIO_OType = GPIO_OType_PP;
  GPIO_InitDef.GPIO_PuPd = GPIO_PuPd_NOPULL;
  GPIO_InitDef.GPIO_Speed = GPIO_Speed_100MHz;
  //Initialize pins
  GPIO_Init(GPIOD, &GPIO_InitDef);
}

float SupportVectors[125][26]={{-25.016813,1.674782,0.570302,0.055831,0.542827,0.195742,-0.408398,-0.154678,-0.129031,-0.065453,-0.005136,-0.338932,0.408109,31.962882,0.807270,1.040891,0.257747,0.267930,0.118487,0.154393,0.138944,0.156755,0.056090,0.203793,0.199853,0.190082},
{-20.913284,1.588457,0.666204,0.050123,0.331438,0.203750,0.294239,0.134841,0.079160,-0.298463,-0.116695,-0.374979,0.093225,87.281118,3.258930,0.563078,0.093044,0.213056,0.155831,0.200358,0.152310,0.106339,0.115771,0.104865,0.211828,0.168822},
{-25.894186,0.843509,-0.058631,0.643821,0.167292,0.189467,-0.510659,-0.306875,-0.437351,-0.066706,-0.092706,-0.205270,-0.335486,26.948295,2.306288,0.277463,0.114741,0.113568,0.132388,0.189681,0.116535,0.150499,0.111565,0.123296,0.140659,0.153987},
{-25.325273,0.912474,0.192047,0.438090,0.149315,0.062922,-0.456985,-0.274804,-0.297498,-0.081469,-0.114463,-0.157783,-0.153322,50.080355,1.400112,0.712126,0.294951,0.090390,0.134029,0.224551,0.102585,0.100119,0.086245,0.096345,0.078083,0.073046},
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{-19.661470,3.476386,1.098296,0.689789,0.192782,-0.568104,-0.685349,-0.227101,-0.131196,-0.235965,-0.512637,-0.405461,-0.567374,30.693445,1.093871,0.706710,0.168656,0.198293,0.224114,0.197553,0.255491,0.126128,0.137661,0.223890,0.260040,0.079260}};

float SupportVectorLabels[125]={1,1,1,1,1,1,1,1,-1,-1,-1,-1,-1,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1,1};

float Alpha[125]={1.000000,0.360344,1.000000,1.000000,1.000000,0.052341,0.180822,1.000000,1.000000,1.000000,1.000000,1.000000,0.277419,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1.000000,0.568066};
float Bias[4]={-5.236693218225857,-3.096485678836511,-1.536499944760325,-1.533885320485532};


void DMA2_Stream2_IRQHandler(void)
{ 
   int ii,j;
     float c=0,d=0;
     float earMag[40];
     float data[26];               
     
     int support_vector_size[4]={17,33,26,49},classlabel,class[4],length=0;    
     float buffer=0,buffer2=0;

  if(DMA_GetITStatus(DMA2_Stream2, DMA_IT_TCIF2))
 {
   /* Clear DMA Stream Transfer Complete interrupt pending bit */
    DMA_ClearITPendingBit(DMA2_Stream2, DMA_IT_TCIF2);
    for (i=0 ; i<windowLength ; i++)
        {
            usartreal[i]=(((float)usart[2*i]*256+(float)usart[2*i+1])/10000)-1;
            testInput[i].real = usartreal[i] * hamming_window[i];
            testInput[i].imag = 0;
        }
    
    for (i=0 ; i<windowLength/2 ; i++)
      nonpermanentbuffer[i]=usartreal[i+windowLength/2]; 
    
    arm_cfft_radix4_instance_f32 S; // complex fft ayarlarý iþleniyor         
        arm_cfft_radix4_init_f32(&S, windowLength,0, 1); // fft giriþi dörtlük birimlerle iþleniyor //        
        arm_cfft_radix4_f32(&S, (float32_t *)testInput);        
        arm_cmplx_mag_f32((float32_t *)testInput, testOutput, windowLength);  // fft büyüklüklerinin hesabý yapýlýyor //    
     k=1;
    
      for(i=0;i<40;i++)
        {
            c=0;
            for(j=0;j<80;j++)
                c=c+mfccParamsmfccFilterWeights[i][j]*testOutput[j];

            earMag[i]=log10(c + 0.00000000000000022204);
        }

        for(i=0;i<13;i++)
        {
            d=0;
            for(j=0;j<40;j++){
                d=d+mfccParamsmfccDCTMatrix[i][j]*earMag[j];
            }
            ceps[i]=d;
        }

        if(n<40)
        {
            for(i=0;i<13;i++)
            {
                mfccs_block[i][n]=ceps[i];
            }
            n++;
        }
        else
        {
            for(i=0;i<31;i++)
            {   
               collect=mfccs_block[0][i]+mfccs_block[0][i+1]+mfccs_block[0][i+2]+mfccs_block[0][i+3]+mfccs_block[0][i+4]+mfccs_block[0][i+5]+mfccs_block[0][i+6]+mfccs_block[0][i+7]+mfccs_block[0][i+8]+mfccs_block[0][i+9];
               collect2=collect;
               if( collect2 > -200)
               {
                    for(j=0;j<13;j++)
                    {
                        c=0;
                        for(ii=0;ii<40;ii++)
                        {
                            c=c+mfccs_block[j][ii];
                        }
                        data[j]=c/40;

                        d=0;
                        for(ii=0;ii<40;ii++)
                        {
                            d=d+pow((mfccs_block[j][ii]-data[j]),2);
                        }
                        data[j+13]=d/39;

                     }
                     break;
                  }

               }

               n=0;
               for(i=0;i<13;i++)
               {
                   mfccs_block[i][n]=ceps[i];
               }
               n++;
               
                if(data[1]!=0)
               {  
                  for (classlabel=0;classlabel<4;classlabel++)
                  {
                      buffer2=0;

                      for(i=length;i<support_vector_size[classlabel]+length;i++)
                      {
                          buffer=0;

                          for(j=0;j<26;j++)
                          {
                              buffer=buffer+data[j]*SupportVectors[i][j];
                          }

                          buffer2=buffer2+buffer*Alpha[i]*SupportVectorLabels[i];
                      }
                      length=support_vector_size[classlabel]+length;

                      class[classlabel]=(buffer2+Bias[classlabel])>0;

                      if(class[classlabel]==1)
                      {
                          GPIOD->BSRRH = 0xF000;
                          GPIOD->BSRRL = 0x1000<<classlabel; 
                          Delay(0x08FFFFFF);
                          GPIOD->BSRRH = 0xF000;
                          break;
                      }
                  }
              }
              for(i=0;i<26;i++)
                 data[i]=0;
    }
 }              
 if(DMA_GetITStatus(DMA2_Stream2, DMA_IT_HTIF2))
 {
  /* Clear DMA Stream Half Transfer interrupt pending bit */
  DMA_ClearITPendingBit(DMA2_Stream2, DMA_IT_HTIF2); 
  
  if(k==1)
  {
    for (i=0 ; i<windowLength/2 ; i++)
        {
            usartreal[i]=(((float)usart[2*i]*256+(float)usart[2*i+1])/10000)-1;
            testInput[i+windowLength/2].real = usartreal[i] * hamming_window[i+windowLength/2];
            testInput[i+windowLength/2].imag = 0;
            testInput[i].real=nonpermanentbuffer[i] * hamming_window[i];
            testInput[i].imag=0;
        }
       
        arm_cfft_radix4_instance_f32 S; // complex fft ayarlarý iþleniyor         
        arm_cfft_radix4_init_f32(&S, windowLength,0, 1); // fft giriþi dörtlük birimlerle iþleniyor //        
        arm_cfft_radix4_f32(&S, (float32_t *)testInput);        
        arm_cmplx_mag_f32((float32_t *)testInput, testOutput, windowLength);  // fft büyüklüklerinin hesabý yapýlýyor //    
    
      for(i=0;i<40;i++)
        {
            c=0;
            for(j=0;j<80;j++)
                c=c+mfccParamsmfccFilterWeights[i][j]*testOutput[j];

            earMag[i]=log10(c + 0.00000000000000022204);
        }

        for(i=0;i<13;i++)
        {
            d=0;
            for(j=0;j<40;j++){
                d=d+mfccParamsmfccDCTMatrix[i][j]*earMag[j];
            }
            ceps[i]=d;
        }

        if(n<40)
        {
            for(i=0;i<13;i++)
            {
                mfccs_block[i][n]=ceps[i];
            }
            n++;
        }
        else
        {
            for(i=0;i<31;i++)
            {   
               collect=mfccs_block[0][i]+mfccs_block[0][i+1]+mfccs_block[0][i+2]+mfccs_block[0][i+3]+mfccs_block[0][i+4]+mfccs_block[0][i+5]+mfccs_block[0][i+6]+mfccs_block[0][i+7]+mfccs_block[0][i+8]+mfccs_block[0][i+9];
               collect2=collect;
               if( collect2 > -200)
               {
                    for(j=0;j<13;j++)
                    {
                        c=0;
                        for(ii=0;ii<40;ii++)
                        {
                            c=c+mfccs_block[j][ii];
                        }
                        data[j]=c/40;

                        d=0;
                        for(ii=0;ii<40;ii++)
                        {
                            d=d+pow((mfccs_block[j][ii]-data[j]),2);
                        }
                        data[j+13]=d/39;

                     }
                     break;
                  }
               }

               n=0;
               for(i=0;i<13;i++)
               {
                   mfccs_block[i][n]=ceps[i];
               }
               n++;
               
               if(data[1]!=0)
               {           
                  for (classlabel=0;classlabel<4;classlabel++)
                  {
                      buffer2=0;

                      for(i=length;i<support_vector_size[classlabel]+length;i++)
                      {
                          buffer=0;

                          for(j=0;j<26;j++)
                          {
                              buffer=buffer+data[j]*SupportVectors[i][j];
                          }

                          buffer2=buffer2+buffer*Alpha[i]*SupportVectorLabels[i];
                      }
                      length=support_vector_size[classlabel]+length;

                      class[classlabel]=(buffer2+Bias[classlabel])>0;
        
                      if(class[classlabel]==1)
                      {
                          GPIOD->BSRRH = 0xF000;
                          GPIOD->BSRRL = 0x1000<<classlabel;
                          Delay(0x08FFFFFF);
                          GPIOD->BSRRH = 0xF000;
                          k=0;
                          break;
                      }
                  }
               }
               
               for(i=0;i<26;i++)
                 data[i]=0;
        }
  }
    
 }
}
    

int main(void)
{  
    feature_mfccs_init();
    USART1_Configuration(); 
    GPIO_Configuration();
    DMA_Configuration();
    NVIC_Configuration();
    
    for (i=0 ; i<windowLength ; i++)
    {
       hamming_window[i]=0.54-0.46*cos(2*Pi*i/(windowLength-1));
    }
    
    while(1);
}

